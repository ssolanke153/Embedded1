;
; interrupt.asm
;
; Created: 22-05-2020 10:32:43
; Author : Shri

 .INCLUDE "M32DEF.INC"

 .ORG 0x00
 JMP MAIN

 .ORG 0x16
 JMP T0_OV

 .ORG 0x100
 MAIN: LDI R20,HIGH(RAMEND)
       OUT SPH,R20
	   LDI R20,LOW(RAMEND)
	   OUT SPL,R20
	   SBI DDRB,5
	   LDI R20,(1<<TOIE0)
	   OUT TIMSK,R20
	   SEI
	   LDI R20,-32
	   OUT TCNT0,R20
	   LDI R20,0x01
	   OUT TCCR0,R20
	   LDI R20,0x00
	   OUT DDRC,R20
	   LDI R20,0xFF
	   OUT DDRD,R20

HERE:  IN R20,PINC
       OUT PORTD,R20
	   JMP HERE

	   .ORG 0x200
T0_OV:  IN R16,PORTB
LDI R17,0x2
EOR R16,R17
OUT PORTB,R16
LDI R16,-32
OUT TCNT0,R16
RETI

.EXIT

