;
; 4Bit_Display.asm
;
; Created: 7/14/2020 10:37:16 PM
; Author : Shri
;

 .INCLUDE"M32DEF.INC"

.ORG 0

RJMP MAIN

BIT4CMD:

SBRS R16, 0
RJMP else
SBI PORTC, 4
RJMP if1

else:
CBI PORTC, 4

if1:
SBRS R16, 1
RJMP else1
SBI PORTC, 5
RJMP if2

else1:
CBI PORTC, 5

if2:
SBRS R16, 2
RJMP else2
SBI PORTC, 6
RJMP if3

else2:
CBI PORTC, 6

if3:
SBRS R16, 3
RJMP else3
SBI PORTC, 7
RJMP ena

else3:
CBI PORTC, 7

ena:
SBI PORTD, 6
CBI PORTD, 6

RCALL DELAY
RET

SENDCMD:

MOV R28, R16
CBI PORTD, 4
SWAP R16
ANDI R16, 0x0F
RCALL BIT4CMD

MOV R16, R28
RCALL BIT4CMD
RET

SENDATA:

MOV R28, R16
SBI PORTD, 4
SWAP R16
ANDI R16, 0x0F
RCALL BIT4CMD
MOV R16, R28
RCALL BIT4CMD
RET

MAIN1:

SBI DDRD, 4
SBI DDRD, 6

SBI DDRC, 4
SBI DDRC, 5
SBI DDRC, 6
SBI DDRC, 7

CBI PORTD, 4
CBI PORTD, 6

LDI R16, 0x02
RCALL SENDCMD

LDI R16, 0x28
RCALL SENDCMD

LDI R16, 0x0C  
RCALL SENDCMD

LDI R16, 0x06
RCALL SENDCMD
RET


HERE1:

MAIN:

RCALL MAIN1

LDI ZH, HIGH(MYDATA<<1)
LDI ZL, LOW(MYDATA<<1)
 
LDI R24, 0
LDI R17, 17

DATA:
INC R24
CPSE R24, R17
BRNE NEXT
RCALL NEXT1

NEXT:

LPM R16, Z
CPI R16, 0
BREQ HERE
RCALL SENDATA
INC ZL
RCALL DELAY
RJMP DATA

HERE:LDI R16, 0x01
RCALL SENDCMD
RJMP HERE1

NEXT1: 
     LDI R16, 0xC4
	 RCALL SENDCMD
	 RET


DELAY:
LDI R20, 10
H3: LDI R18, 30
H2: LDI R19, 50

H1: 
DEC R19
BRNE H1

DEC R18
BRNE H2

DEC R20
BRNE H3
RET

.ORG 0x100

MYDATA: .DB "EARTH IS BUT ONE COUNTRY",0
RET

.EXIT