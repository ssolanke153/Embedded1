.INCLUDE "M32DEF.INC"
		
START:		SBI DDRC,5
            SBI DDRC,6
		LDI R16,0xFF
		 OUT PORTC,R16
		 CALL DELAY
		 COM R16
		OUT PORTC,R16
		
		
		LDI R17,$FF
		OUT PORTC,R17
		CALL DELAY
		 COM R17
		OUT PORTC,R17
		
		RJMP START

		 
DELAY:    
H3:    LDI R18,100
H2:	   LDI R19,100
      

	H1:  	 
	  NOP
	   NOP
	   NOP
	   NOP
	   NOP
	   NOP
	   NOP  
	   
	 DEC R19
	   BRNE H1


	   DEC R18
	   BRNE H2

	   RET

.EXIT


/*.INCLUDE "M32DEF.INC"

SBI DDRC,5
LDI R16,0xFF
OUT PORTC,R16

AGAIN: LDI R19,255
LOOP1: LDI R18,255
LOOP2:LDI R20,5
LOOP3: NOP

NOP
NOP
NOP
NOP

DEC R20
BRNE LOOP3
DEC R18
BRNE LOOP2

DEC R19
BRNE LOOP1

COM R16
OUT PORTC,R16

RJMP AGAIN

.EXIT
 
*/