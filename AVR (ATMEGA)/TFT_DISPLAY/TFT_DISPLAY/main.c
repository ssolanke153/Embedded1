/*
 * TFT_DISPLAY.c
 *
 * Created: 16-08-2020 09:42:17 AM
 * Author : Shri
 */ 

#define SS 4
#define MOSI 5
#define SCL 7
#define DCX 1
#define F_CPU 8000000UL

#define SWRESET 0x01                   // software reset 
#define SLPOUT  0x11                   // sleep out 
#define DISPOFF 0x28                   // display off 
#define DISPON  0x29                   // display on 
#define CASET   0x2A                   // column address set 
#define RASET   0x2B                   // row address set 
#define RAMWR   0x2C                   // RAM write
#define MADCTL  0x36                   // axis control 
#define COLMOD  0x3A                   // color mode

#define XSIZE   128 
#define YSIZE   160 
#define XMAX    XSIZE-1 
#define YMAX    YSIZE-1

// Color constants 
#define BLACK   0x0000 
#define BLUE    0x001F 
#define RED     0xF800 
#define GREEN   0x0400 
#define LIME    0x07E0 
#define CYAN    0x07FF 
#define MAGENTA 0xF81F 
#define YELLOW  0xFFE0 
#define WHITE   0xFFFF


#include <avr/io.h>                     // deal with port registers 
#include <avr/interrupt.h>              // deal with interrupt calls 
#include <avr/pgmspace.h>               // put character data into progmem 
#include <util/delay.h>                 // used for _delay_ms function 
#include <string.h>                     // string manipulation routines 
#include <avr/sleep.h>                  // used for sleep functions 
#include <stdlib.h>


typedef uint8_t byte;
typedef int8_t sbyte;


const byte FONT_CHARS[96][5]  = {
	{ 0x00, 0x00, 0x00, 0x00, 0x00 }, // (space)
	{ 0x00, 0x00, 0x5F, 0x00, 0x00 }, // !
	{ 0x00, 0x07, 0x00, 0x07, 0x00 }, // "
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	{ 0x08, 0x1C, 0x2A, 0x08, 0x08 } // <-
};




void sendcmd(unsigned char cmd)
{
	PORTB &= ~(1<<SS);
	PORTD &= ~(1<<DCX);
	SPDR = cmd;
	while(!(SPSR & (1<<SPIF)));
	PORTB |= (1<<SS);
	
}

void sendata(unsigned char data)
{
	PORTB &= ~(1<<SS);
	PORTB |= (1<<DCX);
	SPDR = data;
	while(!(SPSR & (1<<SPIF)));
	PORTB |= (1<<SS);
}

void rst()
{
	PORTB &= ~(1<<0);
	_delay_ms(1);
	
	PORTB |= (1<<0);
	_delay_ms(250);
}

void writeword(int w)
{
	sendata(w>>8);
	sendata(w & 0xFF);
}

void SetAddrwindow(byte x0, byte y0, byte x1, byte y1)
{
	sendcmd(CASET);
	writeword(x0);
	writeword(x1);
	sendcmd(RASET);
	writeword(y0);
	writeword(y1);
}



void write565(int data, unsigned int count)
{
	sendcmd(RAMWR);
	
	for (;count>0;count--)
	{
		sendata(data>>8);
		sendata(data&0xFF);
	}
}


void DrawPixel(byte x, byte y, int color)
{
	SetAddrwindow(x,y,x,y);
	write565(color, 1);
}

void Line (int x0, int y0, int x1, int y1, int color)
{
	int dx = abs(x1-x0), sx = x0<x1 ? 1 : -1;     
	int dy = abs(y1-y0), sy = y0<y1 ? 1 : -1;     
	int err = (dx>dy ? dx : -dy)/2, e2;         
	for(;;)
	
	   {         
		   DrawPixel(x0,y0,color);         
		   if (x0==x1 && y0==y1) 
		   {
			   break;
			}         
			e2 = err;         
			if (e2 >-dx) { 
				err -= dy; x0 += sx; 
				}   
			if (e2 < dy) 
			{ 
				err += dx; y0 += sy; 
				}    
			} 
				 
	
}

void ClearScreen()
{
	SetAddrwindow(0,0,XMAX, YMAX);
	sendcmd(RAMWR);
	
	for (unsigned int i = 40960; i>0; --i)
	{
		SPDR = 0;
		while(!(SPSR & 0x80));
	}
}


void LineTest()
{
	ClearScreen();
	int x,y, x0=64, y0=80;
	
	for (x=0;x<XMAX;x+=2)
	{
		 Line(x0,y0,x,0,YELLOW);
	}
	
	 for (y=0;y<YMAX;y+=2) 
	 {
		 Line(x0,y0,XMAX,y,CYAN);
		 }     
	for (x=XMAX;x>0;x-=2)
	 {
		Line(x0,y0,x,YMAX,YELLOW);  
	  }   
	for (y=YMAX;y>0;y-=2) 
	{
		Line(x0,y0,0,y,CYAN);
	}     
	_delay_ms(2000); 
	
	
}

void Putch(char ch, byte x, byte y, int color)
{
	int pixel;
	byte row, col, bit, data, mask = 0x01;
	SetAddrwindow(x,y,x+4,y+6);
	sendcmd(RAMWR);
	
	for (row =0;row<7;row++)
	{
		for (col=0; col<5;col++)
		{
			data = pgm_read_byte(&(FONT_CHARS[ch-32][col]));
			bit = data & mask;
			
			if (bit==0)
			{
				pixel = BLACK;
				
			}
			else{
				pixel=color;
			}
			writeword(pixel);
		}
		mask <<=1;
	}
}






void PortraitChars()
{
  ClearScreen();
  
  for (int i=420;i>0;i--)
  {
	  byte x = i % 21;
	  byte y = i/21;
	  char ascii = (i % 96) +32;
	  Putch(ascii, x*6, y*8, CYAN);
  }
  _delay_ms(2000);
}

int main(void)
{
	DDRB |= (1<<SS) | (1<<MOSI) | (1<<SCL) | (1<<DCX);;
	SPCR = (1<<SPE) | (1<<MSTR) | (1<<SPR0);
	
	rst();
	sendcmd(0x11); //sleep out
	_delay_ms(150);
	sendcmd(0x29); //display on
	sendcmd(0x2D); //color mode on 
	sendata(0x05); // mode = 5
	PortraitChars();
	LineTest();
   
}

