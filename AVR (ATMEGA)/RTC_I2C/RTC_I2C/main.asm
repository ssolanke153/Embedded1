;
; RTC_I2C.asm
;
; Created: 21-07-2020 04:41:46 PM
; Author : Shri
 

.INCLUDE"M32DEF.INC"
 

 CALL I2C_INIT
 
 CALL I2C_START
 LDI R21, 0b11010000
 CALL I2C_SEND
 LDI R21, 0x07
 CALL I2C_SEND
 LDI R21, 0x00
 CALL I2C_SEND
 CALL I2C_STOP

 CALL DELAY

 CALL I2C_START
 LDI R21, 0b11010000
 CALL I2C_SEND
 LDI R21, 0x00
 CALL I2C_SEND
 LDI R21,  0x55
 CALL I2C_SEND
 LDI R21, 0x58
 CALL I2C_SEND
 LDI R21, 0b00010110
 CALL I2C_SEND
 CALL I2C_STOP

 HERE: 
 RJMP HERE

 I2C_INIT:
 LDI R21, 0
 OUT TWSR, R21
 LDI R21, 0x47
 OUT TWBR, R21
 LDI R21, (1<<TWEN)
 OUT TWCR, R21
 RET

 I2C_START:
 LDI R21, (1<<TWINT) | (1<<TWSTA) | (1<<TWEN)
 OUT TWCR, R21
 W1: IN R21, TWCR
 SBRS R21, TWINT
 RJMP W1
 RET

 I2C_SEND:
 OUT TWDR, R21
 LDI R21, (1<<TWINT) | (1<<TWEN)
 OUT TWCR, R21
 W2: IN R21, TWCR
 SBRS R21, TWINT
 RJMP W2
 RET

 I2C_STOP:
 LDI R21, (1<<TWINT) | (1<<TWSTO) | (1<<TWEN)
 OUT TWCR, R21
 W3: IN R21, TWCR
 SBRS R21, TWSTO
 RJMP W3
 RET


 DELAY:
 LDI R22, 0xFF
 A1: DEC R22
 NOP
 BRNE A1
 RET


