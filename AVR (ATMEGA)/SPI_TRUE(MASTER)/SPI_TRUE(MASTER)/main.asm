;
; SPI_TRUE(MASTER).asm
;
; Created: 28-07-2020 02:36:12 PM
; Author : Shri
;

.INCLUDE"M32DEF.INC"
.ORG 0

.equ MOSI = 5
.equ SCK = 7
.equ SS = 4


RJMP MAIN

Transmit:
	CBI PORTB, SS
	OUT SPDR, R27
	wait:
	SBIS SPSR, SPIF
	RJMP wait
	LDI R17, (1<<SPIF)
    OUT SPSR, R17
	RET

SENDATA:
	 MOV R16, R27
	 ANDI R27, 0xF0
	 RCALL SENDATA1

	 MOV R27, R16
	 SWAP R27
	 ANDI R27, 0xF0
	 RCALL SENDATA1
	 RET

 SENDATA1:
	 RCALL Transmit
	 SBR R27, 1
	 RCALL Transmit
	 SBR R27, 4
	 RCALL Transmit
	 CBR R27, 4
	 RCALL Transmit
	 RET

 SENDCMD:
	 MOV R16, R27
	 ANDI R27, 0xF0
	 RCALL SENDCMD1
	 MOV R27, R16
	 SWAP R27
	 ANDI R27, 0xF0
	 RCALL SENDCMD1
	 RET

 SENDCMD1:

	 RCALL Transmit
	 CBR R27, 1
	 RCALL Transmit
	 SBR R27, 4
	 RCALL Transmit
	 CBR R27, 4
	 RCALL Transmit
	 RET

 HERE1:
MAIN:


	 
	// INITIALIZE OF SPI IN MASTER MODE

	LDI R17, (1<<MOSI) | (1<<SCK) | (1<<SS)
	OUT DDRB, R17

	LDI R17, (1<<SPE) | (1<<MSTR) | (1<<SPR0)
	OUT SPCR, R17

	//LCD COMMANDS
	LDI R27, 0x02
	RCALL SENDCMD

	LDI R27, 0x28
	RCALL SENDCMD

	LDI r27, 0x8F
	RCALL SENDCMD


	LDI R27, 0x0C
	RCALL SENDCMD

	LDI R27, 0x06
	RCALL SENDCMD

//START OF DATA SENDING 

	LDI ZH, HIGH(MYDATA<<1)
	LDI ZL, LOW(MYDATA<<1)

/*LDI R24, 0
LDI R17, 17*/

DATA:
/*INC R24
CPSE R24, R17
BRNE NEXT
RCALL NEXT1*/

/*NEXT:*/
	LPM R27, Z
	CPI R27, 0
	BREQ HERE
	RCALL SENDATA
	LDI R27, 0x18
	RCALL SENDCMD
	INC ZL
	RCALL DELAY
	RJMP DATA 

HERE: 
 RCALL DELAY 
LDI R27, 0x01
RCALL SENDCMD
RJMP HERE1


/*NEXT1:
    
     LDI R27, 0xC4
	 RCALL SENDCMD
	 RET*/
 
DELAY:
LDI R20, 20
H3: LDI R18, 30
H2: LDI R19, 100

H1: 
	DEC R19
	BRNE H1

	DEC R18
	BRNE H2

	BRNE H1

	DEC R18
	BRNE H2
	DEC R20
	BRNE H3
	RET

.ORG 0x100

MYDATA: .DB "EARTH IS BUT ONE COUNTRY ",0
RET

