/* .INCLUDE "M328PDEF.INC"

 .ORG $0

START: LDI R16,0xFF
 OUT DDRB,R16
 LDI R16,1
 OUT PORTB,16
 CALL DELAY

 LDI R17,0
 OUT PORTB,R17
 
 RJMP DELAY

 RJMP START

 DELAY:

H2:       LDI R18,100
H1:	   LDI R19,100

	   DEC R19
	   BREQ H1

	   DEC R18
	   BREQ H2

	   RET

.EXIT*/





.INCLUDE "M328PDEF.INC"

START:LDI R20,HIGH(RAMEND)
OUT SPH,R20
LDI R20,LOW(RAMEND)
OUT SPL,R20
LDI R20,0xFF
OUT PORTD,R20
SBI PORTD,0
CALL DELAY
SBI PORTD,1
CALL DELAY
SBI PORTD,2
CALL DELAY
SBI PORTD,3
CALL DELAY
SBI PORTD,4
CALL DELAY
SBI PORTD,5
CALL DELAY
SBI PORTD,6
CALL DELAY
SBI PORTD,7
CALL DELAY

RJMP START

DELAY:

DELAY:

H2:       LDI R18,100
H1:	   LDI R19,100

	   DEC R19
	   BREQ H1

	   DEC R18
	   BREQ H2

	   RET

	   .EXIT