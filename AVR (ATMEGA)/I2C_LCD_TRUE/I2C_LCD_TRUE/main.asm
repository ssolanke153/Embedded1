;
; I2C_LCD_TRUE.asm
;
; Created: 27-07-2020 05:32:54 PM
; Author : Shri
;


.INCLUDE"M32DEF.INC"

.ORG 0x00
RJMP MAIN

 SENDATA:
 MOV R26, R27
 ANDI R27, 0xF0
 RCALL SENDATA1

 MOV R27, R26
 SWAP R27
 ANDI R27, 0xF0
 RCALL SENDATA1
 RET

 SENDATA1:
 RCALL I2C_WRITE
 SBR r27, 1
 RCALL I2C_WRITE
 SBR r27, 4
 RCALL I2C_WRITE
 CBR r27, 4
 RCALL I2C_WRITE
 RET

 SENDCMD:
 MOV R26, R27
 ANDI R27, 0xF0
 RCALL SENDCMD1
 MOV R27, R26
 SWAP R27
 ANDI R27, 0xF0
 RCALL SENDCMD1
 RET

 SENDCMD1:
 RCALL I2C_WRITE
 CBR r27, 1
 RCALL I2C_WRITE
 SBR r27, 4
 RCALL I2C_WRITE
 CBR r27, 4
 RCALL I2C_WRITE
 RET

 I2C_INIT:
 LDI R21, 0
 OUT TWSR, R21
 LDI R21, 0x47
 OUT TWBR, R21
 LDI R21, (1<<TWEN)
 OUT TWCR, R21
 RET

I2C_START:
 LDI R21, (1<<TWINT) | (1<<TWSTA) | (1<<TWEN)
 OUT TWCR, R21

 WAIT1:
 IN R21, TWCR
 SBRS R21, TWINT
 RJMP WAIT1
 RET

 I2C_WRITE:
 OUT TWDR, R27
 LDI R21, (1<<TWINT) | (1<<TWEN)
 OUT TWCR,R21

WAIT3:
IN R21, TWCR
SBRS R21, TWINT
RJMP WAIT3
RET

I2C_STOP:
LDI R21, (1<<TWINT) | (1<<TWSTO) | (1<<TWEN)
OUT TWCR, R21
RET

HERE1:
MAIN:

//TWI-MASTER ENABLE

RCALL I2C_INIT
RCALL I2C_START
LDI R27, 0b11010000
RCALL I2C_WRITE

//LCD COMMANDS
LDI R27, 0x02
RCALL SENDCMD

LDI R27, 0x28
RCALL SENDCMD

LDI r27, 0x8F
RCALL SENDCMD


LDI R27, 0x0C
RCALL SENDCMD

LDI R27, 0x06
RCALL SENDCMD

//START OF DATA SENDING 

LDI ZH, HIGH(MYDATA<<1)
LDI ZL, LOW(MYDATA<<1)

/*LDI R24, 0
LDI R17, 17*/

DATA:
/*INC R24
CPSE R24, R17
BRNE NEXT
RCALL NEXT1*/

/*NEXT:*/
LPM R27, Z
CPI R27, 0
BREQ HERE
RCALL SENDATA
LDI R27, 0x18
RCALL SENDCMD
INC ZL
RCALL DELAY
RJMP DATA 

HERE: 
 RCALL DELAY 
LDI R27, 0x01
RCALL SENDCMD
RJMP HERE1


/*NEXT1:
    
     LDI R27, 0xC4
	 RCALL SENDCMD
	 RET*/
 
DELAY:
LDI R20, 20
H3: LDI R18, 30
H2: LDI R19, 100

H1: 
DEC R19
BRNE H1

DEC R18
BRNE H2

DEC R20
BRNE H3
RET

.ORG 0x100

MYDATA: .DB "EARTH IS BUT ONE COUNTRY",0
RET
