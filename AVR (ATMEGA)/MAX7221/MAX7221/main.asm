.INCLUDE"M32DEF.INC"

.EQU MOSI = 5
.EQU SCK = 7
.EQU SS = 4


	LDI R17, (1<<MOSI) | (1<< SCK) | (1<<SS)
	OUT DDRB, R17

	LDI R17, (1<<SPE) | (1<<MSTR) | (1<<SPR0)
	OUT SPCR, R17

	LDI R17, 0x09
	LDI R18, 0b00000001
	RCALL RUNCMD

	LDI R17, 0x0B
	LDI R18, 0x01
	CALL RUNCMD

	LDI R17, 0x0C
	LDI R18, 0x01
	RCALL RUNCMD

;LDI R17, (1<<SPE) | (1<<MSTR) | (1<<SPR0)


	LDI R17, 0x01
	LDI R18, 0x05
	RCALL RUNCMD




	;LDI R17, (1<<SPE) | (1<<MSTR) | (1<<SPR0)

	;OUT SPCR, R17

	LDI R17, 0x09
	LDI R18, 0b00000001
	RCALL RUNCMD

	LDI R17, 0x02
	LDI R18, 0x07
	RCALL RUNCMD

 
H:RJMP H

RUNCMD:
	CBI PORTB, SS
	OUT SPDR, R17
WAIT1:
	SBIS SPSR, SPIF
	RJMP WAIT1

	OUT SPDR, R18

WAIT2:
	SBIS SPSR, SPIF
	RJMP WAIT2

	SBI PORTB, SS
RET

