; receive transmite.asm
;
; Created: 28-05-2020 11:16:26
; Author : Shri
 

.INCLUDE "M32DEF.INC"

		 LDI R21,0x00
		 OUT DDRA,R21
		 LDI R21,0xFF
		 OUT DDRB,R21

		 LDI R21,HIGH(RAMEND)
		 OUT SPH,R21
		 LDI R21,LOW(RAMEND)
		 OUT SPL,R21

		 LDI R16,(1<<TXEN) | (1<<RXEN)
		 OUT UCSRB,R16
		 LDI R16,(1<<UCSZ1) | (1<<UCSZ0) | (1<<URSEL)
		 OUT UCSRC,R16
		 LDI R16,0x33
		 OUT UBRRL,R16

		 LDI R17,'Y'
		 CALL TRANSMT
		 LDI R17,'E'
		 CALL TRANSMT
		 LDI R17,'S'
		 CALL TRANSMT

 AGAIN: 
		 SBIS UCSRA,RXC
		 RJMP SKIP_RX
		 IN R17,UDR
		 OUT PORTB,R17

 SKIP_RX:
		 SBIS UCSRA,UDRE
		 RJMP SKIP_TX
		 IN R17,PINA
		 OUT UDR,R17

 SKIP_TX:
		 RJMP AGAIN

 TRANSMT:
		 SBIS UCSRA,UDRE
		 RJMP TRANSMT
		 OUT UDR,R17
		 RET

 .EXIT
