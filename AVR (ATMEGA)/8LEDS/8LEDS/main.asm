;
; 8LEDS.asm
;
; Created: 02-06-2020 17:49:32
; Author : Shri
 

 .INCLUDE "M32DEF.INC"

 .ORG 0
     JMP MAIN

.ORG 0x16
     JMP T0_OV

.ORG 0x100

MAIN:
     LDI R20, HIGH(RAMEND)
	 OUT SPH, R20
	 LDI R20, LOW(RAMEND)
	 OUT SPL, R20

	 SBI DDRB, 5
	 LDI R20, (1<<TOIE0)
	 OUT TIMSK,R20
	 SEI

	 LDI R20, -32
	 OUT TCNT0, R20
	 LDI R20, 0x01
	 OUT TCCR0, R20
	 LDI R20, 0x00
	 OUT DDRC, R20
	 LDI R20, 0xFF
	 OUT DDRD, R20

HERE:
     IN R20, PINC
	 OUT PORTD, R20
	 JMP HERE

.ORG 0x200
T0_OV:
     IN R16, PORTB
	 LDI R17, 0x20
	 EOR R16, R17
	 OUT PORTB, R16
	 LDI R16, -32
	 OUT TCNT0, R16

	 RETI



	 .EXIT

