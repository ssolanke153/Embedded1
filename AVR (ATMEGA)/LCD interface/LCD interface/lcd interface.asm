;
; LCD interface.asm
;
; Created: 06-05-2020 3.41.46 PM
; Author : Shri
;



 .INCLUDE "M32DEF.INC"

 .ORG $0
 LDI R17,0xFF
 OUT DDRC,R17
 OUT DDRD,R17




START:
   LDI ZL,(100<<1)
 LDI ZH,(100<<1)

 LDI R16,0x38
 RCALL COMMAND

 LDI R16,0x01
 RCALL COMMAND

 LDI R16,0x0C
 RCALL COMMAND

 LDI R16,0x06
 RCALL COMMAND

  LDI R16,0x80
 RCALL COMMAND


 ;LOOK UP TABLE OR DEFINITE BITE


RPT1: LPM R16,Z
      RCALL DISPLAY
	  INC ZL
	  CPI R16,0
     BRNE RPT1

 /*LDI R16,'S'
 RCALL DISPLAY

  LDI R16,'H'
 RCALL DISPLAY

  LDI R16,'R'
 RCALL DISPLAY
  LDI R16,'I'
 RCALL DISPLAY

  LDI R16,'K'
 RCALL DISPLAY


  LDI R16,'A'
 RCALL DISPLAY

  LDI R16,'N'
 RCALL DISPLAY

  LDI R16,'T'
 RCALL DISPLAY

 LDI R16,$C7
 RCALL COMMAND

  LDI R16,'S'
 RCALL DISPLAY

  LDI R16,'O'
 RCALL DISPLAY

  LDI R16,'L'
 RCALL DISPLAY

  LDI R16,'A'
 RCALL DISPLAY

  LDI R16,'N'
 RCALL DISPLAY

  LDI R16,'K'
 RCALL DISPLAY


  LDI R16,'E'
 RCALL DISPLAY

 MOV R19,R22
 RCALL CONV
*/

 /*RJMP START

  CONV:

	   LDI R18,10
	   CLR R16*/

	   RJMP START

RPT:	   INC R23
	   SUB R19,R18
	   BRCC RPT

	   CLR R16
	   DEC R23
	   MOV R16,R23
	   ORI R16,$30
	   RCALL DISPLAY


	   CLR R16
	   ADD R19,R18
	   MOV R16,R19
	   ORI R16,$30
	   RCALL DISPLAY
	   RET





	   /*ORI R16,$30
	   RCALL DISPLAY*/


 DISPLAY:
 OUT PORTD,R16
 SBI PORTB,2
 CBI PORTB,3
 SBI PORTB,4
 CBI PORTB,4
 RCALL DELAY
 RET


 COMMAND:
 OUT PORTC,R16
 CBI PORTD,2
 CBI PORTD,3
 SBI PORTD,4
 CBI PORTD,4
 RCALL DELAY
 RET




 DELAY:

       LDI R20,100
H2:	   LDI R19,250

H1:	   DEC R19
	   BRNE H1

	   DEC R20
	   BRNE H2

	   RET

	   .ORG 0x100
MYDATA:
       .DB  "RNXG ",0
	   RET



 .EXIT



