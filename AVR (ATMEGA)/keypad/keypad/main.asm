;
; keypad.asm
;
; Created: 29-05-2020 12:29:05
; Author : Shri
 

.INCLUDE "M32DEF.INC"

 .EQU KEY_PORT = PORTC
 .EQU KEY_PIN = PINC
 .EQU KEY_DDR = DDRC
    
LDI R16,0xFF
OUT DDRB,R16


 LDI R16,0x38
 RCALL COMMAND

 LDI R16,0x01
 RCALL COMMAND

 LDI R16,0x0C
 RCALL COMMAND

 LDI R16,0x06
 RCALL COMMAND

  LDI R16,0x80
 RCALL COMMAND

	   LDI R16, HIGH(RAMEND)
	   OUT SPH,R16
	   LDI R16,LOW(RAMEND)
	   OUT SPL, R16
	   LDI R17,0xFF
	   OUT DDRD,R17
	   LDI R16,0xF0
	   OUT KEY_DDR,R16

GROUND_ALL_ROWS:
      LDI R16,0x0F
	  OUT KEY_PORT,R16

WAIT_FOR_RELEASE:
      NOP
	  IN R17,KEY_PIN
	  ANDI R17,0x0F
	  CPI R17,0x0F
	  BRNE WAIT_FOR_RELEASE

WAIT_FOR_KEY:
      NOP 
	  IN R17,KEY_PIN
	  ANDI R17,0x0F
	  CPI R17,0x0F
	  BREQ WAIT_FOR_KEY
	  
	  IN R17,KEY_PIN
	  ANDI R17,0x0F
	  CPI R17,0x0F
	  BREQ WAIT_FOR_KEY
	  LDI R17,0b01111111
	  OUT KEY_PORT,R17
	  NOP
	  IN R17,KEY_PIN
	  ANDI R17,0x0F
	  CPI R17,0x0F
	  BRNE COL1
	  LDI R17,0b10111111
	  OUT KEY_PORT,R17
	  NOP
	  IN R17,KEY_PIN
	  ANDI R17,0x0F
	  CPI R17,0x0F
	  BRNE COL2
	  LDI R17,0b11011111
	  OUT KEY_PORT,R17
	  NOP
	  IN R17,KEY_PIN
	  ANDI R17,0x0F
	  CPI R17,0x0F
	  BRNE COL3
	  LDI R21,0b11101111
	  OUT KEY_PORT,R17
	  NOP
	  IN R17,KEY_PIN
	  ANDI R17,0x0F
	  CPI R17,0x0F
	  BRNE COL4

COL1: 
      LDI R30,LOW(KCODE0<<1)
	  LDI R31,HIGH(KCODE0<<1)
	  RJMP FIND

COL2: 
      LDI R30,LOW(KCODE1<<1)
	  LDI R31,HIGH(KCODE1<<1)
	  RJMP FIND

COL3: 
      LDI R30,LOW(KCODE2<<1)
	  LDI R31,HIGH(KCODE2<<1)
	  RJMP FIND 

COL4: 
      LDI R30,LOW(KCODE3<<1)
	  LDI R31,HIGH(KCODE3<<1)
	  RJMP FIND

FIND:
      LSR R17
	  BRCC MATCH
	  LPM R16,Z++
	  RJMP FIND

MATCH:
     CBR R21,3
     LPM R16,Z

	 LDI R27, 0x63
	 CPSE R16,R27
	 RJMP H5

	 LDI R16,0x01
     RCALL COMMAND
	 CBR R20,3
	 RJMP JS
	 


 H5: OUT PORTD,R16
	 RCALL DISPLAY

	 LDI R22, 0x3D

	 CPSE R16, R22
	 RJMP H4
	 RJMP RES

	H4:CPI R16, 0x2B
	  BRNE CHE2
	  RJMP SIGN1 

	  
 
 H3:  SBRS R20,1
	  RCALL CONV1
	  SBRS R21, 1
	  RCALL CONV2
	 
	  

JS:  RJMP GROUND_ALL_ROWS

 
 CONV1:
      MOV R18,R16
	  ANDI R18,0x0F
	  SBR R20, 3
	  SBR R21, 3
	  RET
	  
CONV2:
      MOV R19,R16
	  ANDI R19,0x0F
	   

	  RET

SIGN1:
      MOV R23, R16
	  RJMP JS

CHE2:
     CPI R16, 0x2D
	 BRNE CHE3
	 MOV R23, R16
	 RJMP JS
	 RET

CHE3: 
      CPI R16, 0x2A
	  BRNE CHE4
	  MOV R23, R16
	  RJMP JS 
RET

CHE4:
     
	 
     CPI R16, 0x25
	 BRNE H3
	 MOV R23, R16
	 RJMP JS
	 RET
 

RES:
    CLZ
    CPI R23, 0x2B
	BREQ SUM
	RJMP RES1


RES1:
    CPI R23, 0x2D
	BREQ SUBB
	RJMP RES2

RES2: CPI R23, 0x2A
      BREQ MULL
	  RJMP DIV

SUM:
	  ADD R18,R19
	  ORI R18,0x30
	  OUT PORTD, R18
	 
	  RCALL DISPLAY

	  CLR R23
	   
	  RCALL JS

 
	  RET

SUBB:
     LDI R29,'-'
     OUT PORTD,R29
	 RCALL DISPLAY
     SUB R19, R18
	 
	 ORI R19, 0x30
	 
	 
	 OUT PORTD, R19
	 RCALL DISPLAY
	 CLR R23
	 RJMP JS
	 RET



    /* CP R18,R19
	 BRVS SUB1
	BRVC SUB2
     RJMP JS
	 
	 RET*/

/*SUB1:
    CLV
    LDI R29,'-'
     OUT PORTD,R29
	 RCALL DISPLAY
     SUB R19, R18
	 
	 ORI R19, 0x30
	 
	 
	 OUT PORTD, R19
	 RCALL DISPLAY
	 CLR R23
	 RET
	*/ 
	 
/*SUB2:
      
	 RCALL DISPLAY
     SUB R18, R19
	 ORI R18, 0x30
	 OUT PORTD, R18
	 RCALL DISPLAY
	 CLR R23
	 RJMP JS
	 */
	    


MULL:
    MUL R18, R19
	MOV R18, R0
	ORI R18,0x30
	OUT PORTD, R18
	RCALL DISPLAY
	CLR R23
	RJMP JS
	RET


DIV:
   
    LDI R24, 0
	CLC
 
DO:
	INC R24
	SUB R18, R19
	BRCC DO
	 
	 DEC R24
	 ADD R18, R19
	 ORI R24, 0x30
	 OUT PORTD, R24
	 RCALL DISPLAY
	 CLR R23
	 RJMP JS
	 RET

 	  
.ORG 0x300

KCODE0:  .DB '7', '8', '9', '/' 
KCODE1:  .DB '4', '5', '6', '*' 
KCODE2:  .DB '1', '2', '3', '-' 
KCODE3:  .DB 'c', '0', '=', '+' 



 DISPLAY:
 
 SBI PORTB,0
 CBI PORTB,1
 SBI PORTB,2
 CBI PORTB,2
 RCALL DELAY
 RET


COMMAND:
 OUT PORTD,R16
 CBI PORTB,0
 CBI PORTB,1
 SBI PORTB,2
 CBI PORTB,2
 RCALL DELAY
 RET

 DELAY:

       LDI R27,10
H2:	   LDI R26,100

H1:	   DEC R26
	   BRNE H1

	   DEC R27
	   BRNE H2

	   RET

.EXIT